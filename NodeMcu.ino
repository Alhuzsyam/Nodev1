#include <SoftwareSerial.h>
#include <ESP8266WiFi.h>
#include <ESP8266HTTPClient.h>
#include <NTPClient.h>
#include <WiFiUdp.h>

#include <Wire.h>
#include <Adafruit_GFX.h>
#include <Adafruit_SSD1306.h>

#define SCREEN_WIDTH 128
#define SCREEN_HEIGHT 64
String newwaktu;
String waktus;
Adafruit_SSD1306 display(SCREEN_WIDTH, SCREEN_HEIGHT, &Wire, -1);
static const uint8_t image_data_Saraarray[1024] = {
    0xff, 0xff, 0xff, 0xff, 0xff, 0xff, 0xfe, 0x00, 0x00, 0x00, 0x1f, 0xff, 0xff, 0xff, 0xff, 0xff, 
    0xff, 0xff, 0xff, 0xff, 0xff, 0xff, 0xf8, 0x00, 0x00, 0x00, 0x0f, 0xff, 0xff, 0xff, 0xff, 0xff, 
    0xff, 0xff, 0xff, 0xff, 0xff, 0xff, 0xf8, 0x00, 0x00, 0x00, 0x07, 0xff, 0xff, 0xff, 0xff, 0xff, 
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    0xff, 0xff, 0xff, 0xff, 0x00, 0x00, 0x00, 0x1f, 0xff, 0xfc, 0x00, 0x00, 0x03, 0xff, 0xff, 0xff
};
WiFiUDP ntpUDP;
NTPClient timeClient(ntpUDP, "europe.pool.ntp.org", 25200, 60000);

//Node code & id 

String code = "19";
String id = "20";
String waktu;
String interrupt;

const char* ssid ="Alhuzwiri";
const char* password = "00000000";

//Parsing
String payload2;
String content = "";
SoftwareSerial NodeMCU(D8,D7);

#include <NTPClient.h>
#include <WiFiUdp.h>


//Millis 
unsigned long interval        = 1000;
unsigned long previousMillis  = 0;
unsigned long currentMillis   = 0;

void setup(){
Serial.begin(9600);
NodeMCU.begin(115200);
setup_lcd();
pinMode(D7,INPUT);
pinMode(D8,OUTPUT);
pinMode(D5,OUTPUT);
pinMode(D4,OUTPUT);
digitalWrite(D5,HIGH);
delay(100);
digitalWrite(D5,LOW);
connect_s();

timeClient.begin();
Serial.println("=================================");
Serial.println("=====SELMAT DATANG DI TANIKU=====");
Serial.println("=================================");

}

void loop(){

char character;
while(NodeMCU.available()) {
character = NodeMCU.read();
content.concat(character);
}
if (content != "") {
Serial.println(content);
//Serial.println("");
}
Serial.println("Temperature");
Serial.println(content.substring(7, 9));
Serial.println("Humidity");
Serial.println(content.substring(1,3));
Serial.println("Temperature_F");
Serial.println(content.substring(13, 15));
delay(2000);

currentMillis = millis();
  if ((currentMillis - previousMillis) >= interval) {
    waktus = timeClient.getFormattedTime();
    newwaktu = waktus.substring(0,5);
    display.clearDisplay();
    timeClient.update();
    testdrawstyles();
    titles();
    sendt(); 
    get_time();
    
    
    Serial.print(" " + newwaktu);

      if(interrupt == "1"){
        digitalWrite(D5,HIGH);
        }
        else if(newwaktu == waktu){
        digitalWrite(D5,LOW);
        delay(40000);
        Serial.println("ON");
        digitalWrite(D5,HIGH);
        Serial.println("OFF");
        delay(20000);
        }
        else{
          digitalWrite(D5,LOW);
          }
    previousMillis = millis();
  }
delay(1000);


}
